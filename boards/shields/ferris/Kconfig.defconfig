## boards/shields/ferris/Kconfig.defconfig
```kconfig
# Copyright (c) 2020 The ZMK Contributors
# SPDX-License-Identifier: MIT

if SHIELD_FERRIS_CENTRAL

config ZMK_KEYBOARD_NAME
    default "Ferris Dongle"

config ZMK_SPLIT_ROLE_CENTRAL
    default y

endif

if SHIELD_FERRIS_CENTRAL || SHIELD_FERRIS_LEFT || SHIELD_FERRIS_RIGHT

config ZMK_SPLIT
    default y

if ZMK_DISPLAY

config I2C
    default y

config SSD1306
    default y

choice ZMK_DISPLAY_WORK_QUEUE
    default ZMK_DISPLAY_WORK_QUEUE_DEDICATED
endchoice

endif

if SSD1306

config LV_Z_VDB_SIZE
    default 64

config LV_DPI_DEF
    default 148

config LV_Z_BITS_PER_PIXEL
    default 1

choice LV_COLOR_DEPTH
    default LV_COLOR_DEPTH_1
endchoice

endif

endif
```

## boards/shields/ferris/Kconfig.shield
```kconfig
# Copyright (c) 2020 The ZMK Contributors
# SPDX-License-Identifier: MIT
#
config SHIELD_FERRIS_CENTRAL
    def_bool $(shields_list_contains,ferris_central)

config SHIELD_FERRIS_LEFT
    def_bool $(shields_list_contains,ferris_left)

config SHIELD_FERRIS_RIGHT
    def_bool $(shields_list_contains,ferris_right)
```

## boards/shields/ferris/west.yml
```yaml
manifest:
  remotes:
    - name: zmkfirmware
      url-base: https://github.com/zmkfirmware
    - name: gpeye
      url-base: https://github.com/GPeye
    - name: tokyo2006
      url-base: https://github.com/tokyo2006
    - name: englmaxi
      url-base: https://github.com/englmaxi
  projects:
    - name: hammerbeam-slideshow
      remote: gpeye
      revision: main
    - name: zmk
      remote: zmkfirmware
      revision: main
      import: app/west.yml
    - name: prospector-zmk-module # <--- and these
      remote: tokyo2006 # <---
      revision: change_spi2
    - name: zmk-dongle-display
      remote: englmaxi
      revision: main
  self:
    path: config
```

## config/west.yml
```yaml
manifest:
  remotes:
    - name: zmkfirmware
      url-base: https://github.com/zmkfirmware
    - name: zmk
      url-base: https://github.com/nxtkb
    - name: gpeye
      url-base: https://github.com/GPeye
    - name: tokyo2006
      url-base: https://github.com/tokyo2006
    - name: englmaxi
      url-base: https://github.com/englmaxi
  projects:
    - name: hammerbeam-slideshow
      remote: gpeye
      revision: main
    - name: zmk
      remote: zmk
      revision: main
      import: app/west.yml
    - name: prospector-zmk-module
      remote: tokyo2006
      revision: change_spi2
    - name: zmk-dongle-display
      remote: englmaxi
      revision: main
  self:
    path: config
```
